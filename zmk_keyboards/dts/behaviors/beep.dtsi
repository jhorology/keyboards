/*
 * Copyright (c) 2020 The ZMK Contributors
 *
 * SPDX-License-Identifier: MIT
 */

/ {
  behaviors {
    // Behavior can be invoked on peripherals, so name must be <= 8 characters.
    /omit-if-no-ref/ beep: beep {
      compatible = "zmk,behavior-beep";
      #binding-cells = <1>;
      display-name = "Beep";
    };
  };
};
