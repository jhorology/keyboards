## zmk_keyboards/lib/boot/Kconfig
```kconfig
config BOOTSEL_STM32
    bool "Enable bootsel for stm32 SYSTEM_MEMORY bootloader"
    default n
    help
      see details on https://www.st.com/resource/en/application_note/an2606-stm32-microcontroller-system-memory-boot-mode-stmicroelectronics.pdf

if BOOTSEL_STM32

config BOOTSEL_STM32_INIT_PRIORITY
    int "PRE_KERNEL_1 Init Priority"
    default 0

config BOOTSEL_STM32_BOOTLOADER_ADDRESS
    hex "Bootloader address"
    default 0x1FFF0000

config BOOTSEL_STM32_MAGIC
    hex "Magic code for bootloader"
    default 0xDEADBEAF

config BOOTSEL_STM32_REBOOT_TYPE_MASK
    hex "mask bits for sys_reboot type"
    default 0xFFFFFFFF

config BOOTSEL_STM32_ON_FATAL_ERROR
    bool "Reset to bootlader on fatal error"
    default n

endif # BOOTSEL_STM32

config BOOTSEL_UF2_STM32F103
    bool "Enable bootsel for uf2-stm32f103 bootlader"
    depends on SOC_SERIES_STM32F1X
    default n
    help
      see details on https://github.com/mmoskal/uf2-stm32f103

if BOOTSEL_UF2_STM32F103

config BOOTSEL_UF2_STM32F103_MAGIC_APP
    hex "Magic code for application"
    default 0x3f82722a

config BOOTSEL_UF2_STM32F103_MAGIC_UF2
    hex "Magic code for uf2 bootloader"
    default 0x544F4F42

config BOOTSEL_UF2_STM32F103_MAGIC_UF2_REBOOT_TYPE_MASK
    hex "mask bits for sys_reboot type"
    default 0xFFFFFFFF

config BOOTSEL_UF2_STM32F103_ON_FATAL_ERROR
    bool "Reset to bootlader on fatal error"
    default n

endif # BOOTSEL_UF2_STM32F103
```

## zmk_keyboards/lib/boot/bootsel_uf2_stm32f103/Kconfig
```kconfig
config BOOTSEL_UF2_STM32F103
    bool "Enable bootsel for uf2-stm32f103 bootlader"
    depends on SOC_SERIES_STM32F1X
    default y if BOARD_FK680PRO_V2
    help
        see details on https://github.com/mmoskal/uf2-stm32f103

if BOOTSEL_UF2_STM32F103

config BOOTSEL_UF2_STM32F103_MAGIC_APP
    hex "Magic code for application"
    default 0x3f82722a

config BOOTSEL_UF2_STM32F103_MAGIC_UF2
    hex "Magic code for uf2 bootloader"
    default 0x544F4F42

config BOOTSEL_UF2_STM32F103_MAGIC_UF2_REBOOT_TYPE_MASK
    hex "mask bits for sys_reboot type"
    default 0xFFFFFFFF

config BOOTSEL_UF2_STM32F103_ON_FATAL_ERROR
    bool "Reset to bootlader on fatal error"
    default y if BOARD_FK680PRO_V2

endif # BOOTSEL_UF2_STM32F103
```

## zmk_keyboards/lib/bootsel_stm32/Kconfig
```kconfig
config BOOTSEL_STM32
    bool "Enable bootsel for stm32 SYSTEM_MEMORY bootloader"
    help
        see details on https://www.st.com/resource/en/application_note/an2606-stm32-microcontroller-system-memory-boot-mode-stmicroelectronics.pdf

if BOOTSEL_STM32

config BOOTSEL_STM32_BOOTLOADER_ADDRESS
    hex "Bootloader address"
    default 0x1FFF0000

config BOOTSEL_STM32_MAGIC
    hex "Magic code for bootloader"
    default 0xDEADBEAF

config BOOTSEL_STM32_ON_FATAL_ERROR
    bool "Reset to bootlader on fatal error"

endif # BOOTSEL_STM32
```

## zmk_keyboards/lib/bootsel_uf2_stm32f103/Kconfig
```kconfig
config BOOTSEL_UF2_STM32F103
    bool "Enable bootsel for uf2-stm32f103 bootlader"
    depends on SOC_SERIES_STM32F1X
    help
        see details on https://github.com/mmoskal/uf2-stm32f103

if BOOTSEL_UF2_STM32F103

config BOOTSEL_UF2_STM32F103_MAGIC_APP
    hex "Magic code for application"
    default 0x3f82722a

config BOOTSEL_UF2_STM32F103_MAGIC_UF2
    hex "Magic code for uf2 bootloader"
    default 0x544F4F42

config BOOTSEL_UF2_STM32F103_ON_FATAL_ERROR
    bool "Reset to bootlader on fatal error"

endif # BOOTSEL_UF2_STM32F103
```

## zmk_keyboards/lib/bootsel_via_double_reset/Kconfig
```kconfig
config BOOTSEL_VIA_DOUBLE_RESET
    bool "Enable bootsel via double-tap reset"

if BOOTSEL_VIA_DOUBLE_RESET

config BOOTSEL_VIA_DOUBLE_RESET_TIMEOUT_MS
    int "Window(milliseconds) of opportunity for a second press of a reset button to enter BOOTSEL mode"
    default 200

config BOOTSEL_VIA_DOUBLE_RESET_TYPE
  int "An argument of the sys_reboot function for BOOTSEL mode"
  default 1

endif
```

## zmk_keyboards/lib/shell/Kconfig
```kconfig
config CUSTOM_SHELL_CMD
  bool "Enable custom shell command"
  default y
  depends on SHELL

config RP2_FLASH_INFO_SHELL
  bool "rp2 flash info shell"
  default y
  depends on CUSTOM_SHELL_CMD
  depends on PICOSDK_USE_FLASH

config INPUT_ANALOG_AXIS_SHELL
  bool "input analog-axis shell"
  default y
  depends on CUSTOM_SHELL_CMD
  depends on INPUT_ANALOG_AXIS
```

## zmk_keyboards/lib/zmk/Kconfig
```kconfig
# TODO maybe better to define in device-tree as property of keymap
config ZMK_HID_EXTRA_KEYS
    bool "Enable extra keys"
    default n

if ZMK_HID_EXTRA_KEYS

# --------------------------------------------
# CONFIG_ZMK_EXTRA_KEY_n (n=0...7)
#  value : 0xaabbcccc
#   aa bit24..31: usage page for collection
#   bb bit16..23: usage for collection if aa != 0
#                 usage page if aa == 0
#   cccc bit0..15: usage
#  keycode in keymap -> 0x00ff000x
#    x 0-7 extra key index
#  TODO  16bit usage/usage_page is not supported
#  TODO  maybe better to define in device-tree
# --------------------------------------------

config ZMK_HID_EXTRA_KEY_0
    hex "Extra key code 0"
    default 0x0
config ZMK_HID_EXTRA_KEY_1
    hex "Extra key code 1"
    default 0x0
config ZMK_HID_EXTRA_KEY_2
    hex "Extra key code 2"
    default 0x0
config ZMK_HID_EXTRA_KEY_3
    hex "Extra key code 3"
    default 0x0
config ZMK_HID_EXTRA_KEY_4
    hex "Extra key code 4"
    default 0x0
config ZMK_HID_EXTRA_KEY_5
    hex "Extra key code 5"
    default 0x0
config ZMK_HID_EXTRA_KEY_6
    hex "Extra key code 6"
    default 0x0
config ZMK_HID_EXTRA_KEY_7
    hex "Extra key code 7"
    default 0x0

endif # ZMK_HID_EXTRA_KEYS

config ZMK_USB_HOST_OS
    bool "Enable detecting USB host os"

if ZMK_USB_HOST_OS

config ZMK_USB_HOST_OS_DEBUG
    bool "Enable debug for USB_HOST_OS"
    default y if ZMK_CUSTOM_SHELL_CMD

endif

config ZMK_USB_AUTO_SWITCH_LAYER
    bool "Enable auto switch layer"
    default n
    select ZMK_USB_HOST_OS

if ZMK_USB_AUTO_SWITCH_LAYER

config ZMK_USB_AUTO_SWITCH_LAYER_IF_DARWIN
    int "Mac layer"

config ZMK_USB_AUTO_SWITCH_LAYER_UNLESS_DARWIN
    int "Win layer"

endif # ZMK_AUTO_SWITCH_LAYER


config ZMK_RADIAL_CONTROLLER
    bool "Enable ZMK Radial Controller"
    default n

if ZMK_RADIAL_CONTROLLER

config ZMK_BLE_RADIAL_CONTROLLER_REPORT_QUEUE_SIZE
    int "Max number of radial controller HID reports to queue for sending over BLE"
    default 5

endif # ZMK_RADIAL_CONTROLLER

config ZMK_CUSTOM_SHELL_CMD
    bool "Enable custom shell command"
    default y if SHELL

config ZMK_INDICATOR_LED
    bool "Enable indicator LEDs"
    select LED
    select ZMK_HID_INDICATORS

config ZMK_PWM_BUZZER
    bool "Enable PWM buzzer"
    depends on PWM
    select ZMK_LOW_PRIORITY_WORK_QUEUE

config ZMK_BEEP
    bool "Enable beep for output status"
    select ZMK_PWM_BUZZER

rsource "display/Kconfig"
```

## zmk_keyboards/lib/zmk/display/80x128_mono/Kconfig
```kconfig
# Copyright (c) 2024 The ZMK Contributors
# SPDX-License-Identifier: MIT

config ZMK_WIDGET_BATTERY_STATUS_80X128_MONO
    bool "Widget for battery charge information, using small icons"
    depends on BT
    select LV_USE_SPAN

config ZMK_WIDGET_OUTPUT_STATUS_80X128_MONO
    bool "Widget for keyboard output status icons"
    depends on BT && (!ZMK_SPLIT_BLE || ZMK_SPLIT_ROLE_CENTRAL)
    select LV_USE_SPAN

config ZMK_WIDGET_LAYER_STATUS_80X128_MONO
    bool "Built in status screen"
    depends on !ZMK_SPLIT || ZMK_SPLIT_ROLE_CENTRAL
    select LV_USE_SPAN

config ZMK_WIDGET_PERIPHERAL_STATUS_80X128_MONO
    bool "Widget for split peripheral status icons"
    depends on BT && ZMK_SPLIT_BLE && !ZMK_SPLIT_ROLE_CENTRAL
    select LV_USE_LABEL

config ZMK_DISPLAY_STATUS_SCREEN_CUSTOM_80X128_MONO
    bool "Custom status screen form 80x128 mono display"
    select ZMK_DISPLAY
    select LV_USE_IMG
    select LV_USE_LABEL
    imply LV_USE_THEME_MONO
    imply ZMK_WIDGET_BATTERY_STATUS_80X128_MONO
    imply ZMK_WIDGET_OUTPUT_STATUS_80X128_MONO
    imply ZMK_WIDGET_LAYER_STATUS_80X128_MONO
    imply ZMK_WIDGET_PERIPHERAL_STATUS_80X128_MONO

if ZMK_DISPLAY_STATUS_SCREEN_CUSTOM_80X128_MONO

choice ZMK_DISPLAY_STATUS_SCREEN
    default ZMK_DISPLAY_STATUS_SCREEN_CUSTOM
endchoice

config ZMK_WIDGET_BATTERY_STATUS
    depends on !ZMK_WIDGET_BATTERY_STATUS_80X128_MONO

config ZMK_WIDGET_OUTPUT_STATUS
    depends on !ZMK_WIDGET_OUTPUT_STATUS_80X128_MONO

config ZMK_WIDGET_LAYER_STATUS
    depends on !ZMK_WIDGET_LAYER_STATUS_80X128_MONO

config ZMK_WIDGET_PERIPHERAL_STATUS
    depends on !ZMK_WIDGET_PERIPHERAL_STATUS_80X128_MONO

config ZMK_DISPLAY_DEDICATED_THREAD_STACK_SIZE
    default 4096

choice LV_COLOR_DEPTH
   default LV_COLOR_DEPTH_1
endchoice

config LV_Z_VDB_SIZE
    default 100

config LV_Z_MEM_POOL_SIZE
    default 4096

config LV_FONT_MONTSERRAT_12
    default y

choice LV_FONT_DEFAULT
    default LV_FONT_DEFAULT_MONTSERRAT_12
endchoice

# TODO purge unused built-in fonts

endif # ZMK_DISPLAY_STATUS_SCREEN_CUSTOM_80X128_MONO
```

## zmk_keyboards/lib/zmk/display/Kconfig
```kconfig
# Copyright (c) 2024 The ZMK Contributors
# SPDX-License-Identifier: MIT

config ZMK_CUSTOM_KEYBOARD_LOGO
  bool "Enable custom keyboard logo"

config ZMK_DISPLAY_STATUS_PRESENTER
  bool "Enable staus presener"

rsource "Kconfig.portrait_mono"
rsource "custom_widgets/Kconfig"
rsource "fonts/Kconfig"
rsource "img/Kconfig"
```

## zmk_keyboards/lib/zmk/display/Kconfig.68x160_mono
```kconfig
# Copyright (c) 2024 The ZMK Contributors
# SPDX-License-Identifier: MIT

config ZMK_DISPLAY_STATUS_SCREEN_CUSTOM_68X160_MONO
  bool "Custom status screen for 80x128 mono display"
  select ZMK_DISPLAY
  select ZMK_DISPLAY_STATUS_SCREEN_CUSTOM_68X160_MONO_CENTRAL if !ZMK_SPLIT || ZMK_SPLIT_ROLE_CENTRAL
  select ZMK_DISPLAY_STATUS_SCREEN_CUSTOM_68X160_MONO_PERIPHERAL if ZMK_SPLIT && !ZMK_SPLIT_ROLE_CENTRAL

config ZMK_DISPLAY_STATUS_SCREEN_CUSTOM_68X160_MONO_CENTRAL
  bool "Custom status screen for 80x128 mono display"
  select ZMK_DISPLAY_STATUS_PRESENTER
  select ZMK_FONT_MICRO5_9
  select ZMK_FONT_COZETTA_ICONS_13 if ZMK_WIDGET_BLE_STATUS_16X12 && ZMK_WIDGET_USB_STATUS_16X12
  select ZMK_IMG_LOGO_40X40
  select LV_USE_FLEX
  select LV_USE_IMG
  select LV_USE_LABEL
  select LV_USE_THEME_MONO
  imply ZMK_WIDGET_BLE_STATUS_16X12
  imply ZMK_WIDGET_USB_STATUS_16X12
  imply ZMK_WIDGET_BATTERY_STATUS_23X12
  imply ZMK_WIDGET_LAYER_STATUS_H15
  # imply ZMK_WIDGET_LAYER_INDICATORS_H9
  imply ZMK_WIDGET_HID_INDICATORS_H11

config ZMK_DISPLAY_STATUS_SCREEN_CUSTOM_68X160_MONO_PERIPHERAL
  bool "Custom status screen for 80x128 mono display"
  select ZMK_DISPLAY_STATUS_PRESENTER
  select ZMK_FONT_PIXEL_MPLUS_10
  select ZMK_IMG_STARMAN_68X80 if !ZMK_CUSTOM_KEYBOARD_LOGO
  select LV_USE_FLEX
  select LV_USE_IMG
  select LV_USE_LABEL
  select LV_USE_THEME_MONO
  imply ZMK_WIDGET_BATTERY_STATUS_23X12
  imply ZMK_WIDGET_PERIPHERAL_STATUS_36X12

if ZMK_DISPLAY_STATUS_SCREEN_CUSTOM_68X160_MONO

choice ZMK_DISPLAY_STATUS_SCREEN
  default ZMK_DISPLAY_STATUS_SCREEN_CUSTOM
endchoice

choice ZMK_DISPLAY_WORK_QUEUE
  default ZMK_DISPLAY_WORK_QUEUE_DEDICATED
endchoice

choice LV_COLOR_DEPTH
  default LV_COLOR_DEPTH_1
endchoice

config LV_Z_VDB_SIZE
  default 100

config LV_Z_MEM_POOL_SIZE
  default 12288

# TODO purge unused built-in fonts

endif # ZMK_DISPLAY_STATUS_SCREEN_CUSTOM_68X160_MONO
```

## zmk_keyboards/lib/zmk/display/Kconfig.80x128_mono
```kconfig
# Copyright (c) 2024 The ZMK Contributors
# SPDX-License-Identifier: MIT

config ZMK_DISPLAY_STATUS_SCREEN_CUSTOM_80X128_MONO
    bool "Custom status screen form 80x128 mono display"
    select ZMK_DISPLAY
    select ZMK_FONT_PIXEL_MPLUS_BOLD_10
    select ZMK_FONT_TEKO_BOLD_15 if !ZMK_SPLIT || ZMK_SPLIT_ROLE_CENTRAL
    select ZMK_FONT_COZETTA_ICONS_13 if !ZMK_SPLIT || ZMK_SPLIT_ROLE_CENTRAL
    select ZMK_IMG_LOGO_40X40 if !ZMK_SPLIT || ZMK_SPLIT_ROLE_CENTRAL
    select ZMK_IMG_STARMAN_80X80 if ZMK_SPLIT && !ZMK_SPLIT_ROLE_CENTRAL && !ZMK_CUSTOM_KEYNOARD_LOGO
    select ZMK_WIDGET_ENDPOINT_INDICATOR if ZMK_WIDGET_BLE_STATUS_16X12 && ZMK_WIDGET_USB_STATUS_16X12
    select LV_USE_FLEX
    select LV_USE_IMG
    select LV_USE_LABEL
    select LV_USE_THEME_MONO
    imply ZMK_WIDGET_BLE_STATUS_16X12
    imply ZMK_WIDGET_USB_STATUS_16X12
    imply ZMK_WIDGET_BATTERY_STATUS_32X12
    imply ZMK_WIDGET_LAYER_STATUS_H15
    imply ZMK_WIDGET_PERIPHERAL_STATUS_36X12

if ZMK_DISPLAY_STATUS_SCREEN_CUSTOM_80X128_MONO

choice ZMK_DISPLAY_STATUS_SCREEN
    default ZMK_DISPLAY_STATUS_SCREEN_CUSTOM
endchoice

config ZMK_WIDGET_BATTERY_STATUS
   depends on !ZMK_DISPLAY_STATUS_SCREEN_CUSTOM_80X128_MONO

config ZMK_WIDGET_OUTPUT_STATUS
    depends on !ZMK_WIDGET_BATTERY_STATUS_80X128_MONO

config ZMK_WIDGET_LAYER_STATUS
    depends on !ZMK_WIDGET_OUTPUT_STATUS_80X128_MONO

config ZMK_WIDGET_PERIPHERAL_STATUS
    depends on !ZMK_WIDGET_LAYER_STATUS_80X128_MONO

config ZMK_WIDGET_WPM_STATUS
    depends on !ZMK_WIDGET_LAYER_STATUS_80X128_MONO

config ZMK_DISPLAY_DEDICATED_THREAD_STACK_SIZE
    default 4096

choice LV_COLOR_DEPTH
   default LV_COLOR_DEPTH_1
endchoice

config LV_Z_VDB_SIZE
    default 100

config LV_Z_MEM_POOL_SIZE
    default 6144

# TODO purge unused built-in fonts

endif # ZMK_DISPLAY_STATUS_SCREEN_CUSTOM_80X128_MONO
```

## zmk_keyboards/lib/zmk/display/Kconfig.portrait_mono
```kconfig
# Copyright (c) 2024 The ZMK Contributors
# SPDX-License-Identifier: MIT

config ZMK_DISPLAY_CUSTOM_PORTRAIT_MONO
  bool "Custom status screen for 80x128 mono display"
  select ZMK_DISPLAY
  select ZMK_DISPLAY_CUSTOM_PORTRAIT_MONO_MAIN if !ZMK_SPLIT || ZMK_SPLIT_ROLE_CENTRAL
  select ZMK_DISPLAY_CUSTOM_PORTRAIT_MONO_PERIPHERAL if ZMK_SPLIT && !ZMK_SPLIT_ROLE_CENTRAL

config ZMK_DISPLAY_CUSTOM_PORTRAIT_MONO_MAIN
  bool "Custom status screen for portrait mono display"
  select ZMK_DISPLAY_STATUS_PRESENTER
  select ZMK_FONT_MICRO5_10
  select ZMK_IMG_LOGO_40X40
  select LV_USE_FLEX
  select LV_USE_IMG
  select LV_USE_LABEL
  select LV_USE_THEME_MONO
  imply ZMK_WIDGET_CUSTOM_BLE_STATUS
  imply ZMK_WIDGET_CUSTOM_USB_STATUS
  imply ZMK_WIDGET_CUSTOM_BATTERY_STATUS
  imply ZMK_WIDGET_CUSTOM_LAYER_STATUS
  # imply ZMK_WIDGET_CUSTOM_LAYER_INDICATORS
  imply ZMK_WIDGET_CUSTOM_HID_INDICATORS

config ZMK_DISPLAY_CUSTOM_PORTRAIT_MONO_PERIPHERAL
  bool "Custom status screen for portrait mono display"
  select ZMK_DISPLAY_STATUS_PRESENTER
  select ZMK_FONT_MICRO5_10
  select ZMK_IMG_STARMAN_68X80 if !ZMK_CUSTOM_KEYBOARD_LOGO
  select LV_USE_FLEX
  select LV_USE_IMG
  select LV_USE_LABEL
  select LV_USE_THEME_MONO
  imply ZMK_WIDGET_CUSTOM_BATTERY_STATUS
  imply ZMK_WIDGET_CUSTOM_PERIPHERAL_STATUS

if ZMK_DISPLAY_CUSTOM_PORTRAIT_MONO

choice ZMK_DISPLAY_STATUS_SCREEN
  default ZMK_DISPLAY_STATUS_SCREEN_CUSTOM
endchoice

choice ZMK_DISPLAY_WORK_QUEUE
  default ZMK_DISPLAY_WORK_QUEUE_DEDICATED
endchoice

choice LV_COLOR_DEPTH
  default LV_COLOR_DEPTH_1
endchoice

config LV_Z_VDB_SIZE
  default 100

config LV_Z_MEM_POOL_SIZE
  default 12288

# TODO purge unused built-in fonts

endif # ZMK_DISPLAY_CUSTOM_PORTRAIT_MONO
```
