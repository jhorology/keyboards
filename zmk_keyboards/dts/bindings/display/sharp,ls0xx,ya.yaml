## zmk_keyboards/lib/zmk/display/custom_widgets/Kconfig
```kconfig
config ZMK_WIDGET_CUSTOM_BLE_STATUS
  bool "Widget for BLE status"
  depends on ZMK_BLE && (!ZMK_SPLIT || ZMK_SPLIT_ROLE_CENTRAL)
  select ZMK_FONT_PIXEL_MPLUS_BOLD_10
  select ZMK_FONT_COZETTA_ICONS_13
  select LV_USE_FLEX
  select LV_USE_LABEL

config ZMK_WIDGET_CUSTOM_USB_STATUS
  bool "Widget for USB status"
  depends on ZMK_USB && (!ZMK_SPLIT || ZMK_SPLIT_ROLE_CENTRAL)
  select ZMK_FONT_COZETTA_ICONS_13
  select LV_USE_FLEX
  select LV_USE_LABEL

config ZMK_WIDGET_CUSTOM_BATTERY_STATUS
  bool "Widget for battery charge information, using small icons"
  depends on ZMK_BATTERY_REPORTING
  select ZMK_FONT_MICRO5_10
  select ZMK_FONT_COZETTA_ICONS_13
  select LV_USE_FLEX
  select LV_USE_LABEL

config ZMK_WIDGET_CUSTOM_LAYER_STATUS
  bool "Widget for layer status"
  depends on !ZMK_SPLIT || ZMK_SPLIT_ROLE_CENTRAL
  select ZMK_FONT_PIXEL_MPLUS_BOLD_10
  select ZMK_FONT_TEKO_BOLD_15
  select LV_USE_FLEX
  select LV_USE_LABEL

config ZMK_WIDGET_CUSTOM_LAYER_INDICATORS
  bool "Widget for layer status"
  depends on !ZMK_SPLIT || ZMK_SPLIT_ROLE_CENTRAL
  select ZMK_FONT_MICRO5_10
  select LV_USE_FLEX
  select LV_USE_LABEL

config ZMK_WIDGET_CUSTOM_PERIPHERAL_STATUS
  bool "Widget for split peripheral status"
  depends on BT && ZMK_SPLIT && !ZMK_SPLIT_ROLE_CENTRAL
  select ZMK_FONT_MICRO5_10
  select ZMK_FONT_COZETTA_ICONS_13
  select LV_USE_FLEX
  select LV_USE_LABEL

config ZMK_WIDGET_CUSTOM_HID_INDICATORS
  bool "Widget for HID indicators"
  depends on ZMK_HID_INDICATORS && (!ZMK_SPLIT || ZMK_SPLIT_ROLE_CENTRAL)
  select ZMK_FONT_PIXEL_MPLUS_BOLD_10
  select LV_USE_FLEX
  select LV_USE_LABEL
```

## zmk_keyboards/lib/zmk/display/fonts/Kconfig
```kconfig
#------------------------------------------------------------------------------
# tiny5
# https://github.com/Gissio/font_Tiny5
# OFL-1.1 license
#------------------------------------------------------------------------------
config ZMK_FONT_MICRO5_10
  bool "Enable micro5_10 font"

#------------------------------------------------------------------------------
# tiny5
# https://github.com/Gissio/font_Tiny5
# OFL-1.1 license
#------------------------------------------------------------------------------
config ZMK_FONT_TINY5_9
  bool "Enable tiny5_9 font"

config ZMK_FONT_TINY5_BOLD_9
  bool "Enable tiny5_bold_9 font"

#------------------------------------------------------------------------------
# PixelMplus font
# https://github.com/itouhiro/PixelMplus
# M+ FONT license
#------------------------------------------------------------------------------
config ZMK_FONT_PIXEL_MPLUS_10
  bool "Enable pixel_mplus_10 font"

config ZMK_FONT_PIXEL_MPLUS_12
  bool "Enable pixel_mplus_12 font"

config ZMK_FONT_PIXEL_MPLUS_BOLD_10
  bool "Enable pixel_mplus_bold_10 font"

config ZMK_FONT_PIXEL_MPLUS_BOLD_12
  bool "Enable pixel_mplus_bold_12 font"

#------------------------------------------------------------------------------
# teko
# https://github.com/googlefonts/teko
# OFL-1.1 license
# condensed, propotional
#------------------------------------------------------------------------------
config ZMK_FONT_TEKO_15
  bool "Enable teko_15 font"

config ZMK_FONT_TEKO_BOLD_15
  bool "Enable teko_bold_15 font"

#------------------------------------------------------------------------------
# Cozetta 6x13 pixel font
# https://github.com/slavfox/Cozette
# MIT license
#------------------------------------------------------------------------------
config ZMK_FONT_COZETTA_ICONS_13
  bool "Enable cozeeta_icons_13 font for 13pix icons"
```

## zmk_keyboards/lib/zmk/display/img/Kconfig
```kconfig
config ZMK_IMG_LOGO_40X40
  bool "Enable 40x40 ZMK logo"

config ZMK_IMG_STARMAN_80X80
  bool "Enable 80x80 starman"

config ZMK_IMG_STARMAN_68X80
  bool "Enable 80x80 starman"
```

## zmk_keyboards/lib/zmk/display/widgets/Kconfig
```kconfig
config ZMK_WIDGET_BLE_STATUS_16X12
  bool "Widget for BLE status"
  depends on ZMK_BLE && (!ZMK_SPLIT || ZMK_SPLIT_ROLE_CENTRAL)
  select ZMK_FONT_PIXEL_MPLUS_BOLD_10
  select ZMK_FONT_COZETTA_ICONS_13
  select LV_USE_FLEX
  select LV_USE_LABEL

config ZMK_WIDGET_USB_STATUS_16X12
  bool "Widget for USB status"
  depends on ZMK_USB && (!ZMK_SPLIT || ZMK_SPLIT_ROLE_CENTRAL)
  select ZMK_FONT_COZETTA_ICONS_13
  select LV_USE_FLEX
  select LV_USE_LABEL

config ZMK_WIDGET_BATTERY_STATUS_23X12
  bool "Widget for battery charge information, using small icons"
  depends on ZMK_BATTERY_REPORTING
  select ZMK_FONT_MICRO5_10
  select ZMK_FONT_COZETTA_ICONS_13
  select LV_USE_FLEX
  select LV_USE_LABEL

config ZMK_WIDGET_LAYER_STATUS_H15
  bool "Widget for layer status"
  depends on !ZMK_SPLIT || ZMK_SPLIT_ROLE_CENTRAL
  select ZMK_FONT_PIXEL_MPLUS_BOLD_10
  select ZMK_FONT_TEKO_BOLD_15
  select LV_USE_FLEX
  select LV_USE_LABEL

config ZMK_WIDGET_LAYER_INDICATORS_H9
  bool "Widget for layer status"
  depends on !ZMK_SPLIT || ZMK_SPLIT_ROLE_CENTRAL
  select ZMK_FONT_MICRO5_10
  select LV_USE_FLEX
  select LV_USE_LABEL

config ZMK_WIDGET_PERIPHERAL_STATUS_36X12
  bool "Widget for split peripheral status"
  depends on BT && ZMK_SPLIT && !ZMK_SPLIT_ROLE_CENTRAL
  select ZMK_FONT_PIXEL_MPLUS_10
  select ZMK_FONT_COZETTA_ICONS_13
  select LV_USE_FLEX
  select LV_USE_LABEL

config ZMK_WIDGET_HID_INDICATORS_H11
  bool "Widget for HID indicators"
  depends on ZMK_HID_INDICATORS && (!ZMK_SPLIT || ZMK_SPLIT_ROLE_CENTRAL)
  select ZMK_FONT_PIXEL_MPLUS_BOLD_10
  select LV_USE_FLEX
  select LV_USE_LABEL
```

## zmk_keyboards/west.yml
```yaml
manifest:
  remotes:
    - name: zmkfirmware
      url-base: https://github.com/zmkfirmware
    - name: petejohanson
      url-base: https://github.com/petejohanson
    - name: friggeri
      url-base: https://github.com/friggeri
  projects:
    - name: zmk
      remote: zmkfirmware
      revision: main
      clone-depth: 1
      import: app/west.yml
    - name: zmk-analog-joystick-driver
      remote: friggeri
      revision: main
      path: modules/input/zmk-analog-joystick-driver
  # not compatible with #2477 for now
  # - name: zmk-joystick-listener
  #   remote: friggeri
  #   revision: main
  #   path: modules/input/zmk-joystick-listener
  self:
    path: zmk_keyboards
```
