## zmk_keyboards/boards/kbdfans_tofu60_v3_ble/Kconfig
```kconfig
# SPDX-License-Identifier: MIT

config BOARD_ENABLE_DCDC
    bool "Enable DCDC mode"
    select SOC_DCDC_NRF52X
    default n
    depends on BOARD_TOFU60_V3_BLE
```

## zmk_keyboards/boards/kbdfans_tofu60_v3_ble/Kconfig.defconfig
```kconfig
# SPDX-License-Identifier: MIT

if BOARD_TOFU60_V3_BLE

config ZMK_KEYBOARD_NAME
    default "TOFU60 3.0 BLE"

if USB_DEVICE_STACK

config USB_NRFX
    default y

endif # USB_DEVICE_STACK

config BT_CTLR
    default BT

endif # BOARD_TOFU60_V3_BLE
```

## zmk_keyboards/boards/kbdfans_tofu60_v3_ble/Kconfig.tofu60_v3_ble
```kconfig
# SPDX-License-Identifier: MIT

config BOARD_TOFU60_V3_BLE
    select SOC_NRF52840_QIAA
    select ZMK_BOARD_COMPAT
    imply RETAINED_MEM
    imply RETENTION
    imply RETENTION_BOOT_MODE
```

## zmk_keyboards/boards/kbdfans_tofu60_v3_ble/tofu60_v3_ble_defconfig
```kconfig
# SPDX-License-Identifier: MIT

# Enable MPU
CONFIG_ARM_MPU=y

# external RTC
# CONFIG_CLOCK_CONTROL_NRF_K32SRC_RC=n
# CONFIG_CLOCK_CONTROL_NRF_K32SRC_XTAL=y
# CONFIG_CLOCK_CONTROL_NRF_K32SRC_50PPM=y

# no external RTC
CONFIG_CLOCK_CONTROL_NRF_K32SRC_RC=y
CONFIG_CLOCK_CONTROL_NRF_K32SRC_XTAL=n
CONFIG_CLOCK_CONTROL_NRF_K32SRC_500PPM=y
CONFIG_CLOCK_CONTROL_NRF_K32SRC_RC_CALIBRATION=y

# enable pinctrl
CONFIG_PINCTRL=y

# enable GPIO
CONFIG_GPIO=y

# enable SPI
CONFIG_SPI=y

# code partition
CONFIG_USE_DT_CODE_PARTITION=y
CONFIG_BUILD_OUTPUT_UF2=y

# settings
CONFIG_MPU_ALLOW_FLASH_WRITE=y
CONFIG_NVS=y
CONFIG_SETTINGS_NVS=y
CONFIG_FLASH=y
CONFIG_FLASH_PAGE_LAYOUT=y
CONFIG_FLASH_MAP=y

# set TX power level
# CONFIG_BT_CTLR_TX_PWR_PLUS_8=y // Recommended if used in a metal enclosure

CONFIG_ZMK_USB=y
CONFIG_ZMK_BLE=y


# for debug / maintenance
# CONFIG_ADC_SHELL=y
# CONFIG_FLASH_SHELL=y
# CONFIG_SETTINGS_SHELL=y
```

## zmk_keyboards/boards/keychron_q60/q60_defconfig
```kconfig
# Copyright (c) 2023 The ZMK Contributors
# SPDX-License-Identifier: MIT

CONFIG_HW_STACK_PROTECTION=y
CONFIG_ARM_MPU=y
CONFIG_CLOCK_CONTROL=y
CONFIG_PINCTRL=y

# settings
CONFIG_SETTINGS=y
CONFIG_SETTINGS_NVS=y
CONFIG_MPU_ALLOW_FLASH_WRITE=y
CONFIG_NVS=y
CONFIG_FLASH=y
CONFIG_FLASH_PAGE_LAYOUT=y0
CONFIG_FLASH_MAP=y

# Use polling instead of intrrupt for kscan
# some gpio input pins are exists on same EXTI line.
CONFIG_ZMK_KSCAN_MATRIX_POLLING=y

# Increase stack size
# default 1024XB
CONFIG_SYSTEM_WORKQUEUE_STACK_SIZE=2048

# USB
CONFIG_ZMK_USB=y
CONFIG_USB_SELF_POWERED=n

# I2C RGB (SNLED27351)
CONFIG_SPI=n   # CONFIG_ZMK_RGB_UNDERGLOW make default to y
CONFIG_I2C=y
CONFIG_SNLED27351=y
CONFIG_LED_STRIP=y
CONFIG_ZMK_RGB_UNDERGLOW=y
CONFIG_ZMK_RGB_UNDERGLOW_EXT_POWER=n
```

## zmk_keyboards/boards/rz42/Kconfig.defconfig
```kconfig
# Copyright (c) 2024 The ZMK Contributors
# SPDX-License-Identifier: MIT

if BOARD_RZ42_LEFT

config ZMK_KEYBOARD_NAME
    default "RZ42"

config ZMK_SPLIT_ROLE_CENTRAL
    default y

config ZMK_USB
    default y

endif # BOARD_RZ42_LEFT

if BOARD_RZ42_LEFT || BOARD_RZ42_RIGHT

config ZMK_SPLIT
    default y

config ZMK_BLE
    default y

if USB_DEVICE_STACK

config USB_NRFX
    default y

endif # USB_DEVICE_STACK

config ZMK_RGB_UNDERGLOW
    default y
    select WS2812_STRIP_SPI

if ZMK_RGB_UNDERGLOW

config SPI
    default y

config WS2812_STRIP_SPI
    default y

endif # ZMK_RGB_UNDERGLOW

endif # BOARD_RZ42_LEFT || BOARD_RZ42_RIGHT
```

## zmk_keyboards/boards/rz42/Kconfig.rz42_right
```kconfig
# Copyright (c) 2024 The ZMK Contributors
# SPDX-License-Identifier: MIT

config BOARD_RZ42_RIGHT
    bool "RZ42 Right"
    select SOC_NRF52840_QIAA
    select ZMK_BOARD_COMPAT
    imply RETAINED_MEM
    imply RETENTION
    imply RETENTION_BOOT_MODE
```

## zmk_keyboards/boards/rz42/board.yml
```yaml
boards:
  - name: rz42_left
    vendor: zmk
    socs:
      - name: nrf52840
  - name: rz42_right
    vendor: zmk
    socs:
      - name: nrf52840
```

## zmk_keyboards/boards/rz42/rz42_left_defconfig
```kconfig
# Copyright (c) 2024 The ZMK Contributors
# SPDX-License-Identifier: MIT

# Enable MPU
CONFIG_ARM_MPU=y

# Use pinctrl
CONFIG_PINCTRL=y

# enable GPIO
CONFIG_GPIO=y

# Use external 32.768kHz crystal
CONFIG_CLOCK_CONTROL_NRF_K32SRC_RC=n
CONFIG_CLOCK_CONTROL_NRF_K32SRC_XTAL=y
CONFIG_CLOCK_CONTROL_NRF_K32SRC_50PPM=y

# Use internal RC oscillator (no external 32.768kHz crystal)
# CONFIG_CLOCK_CONTROL_NRF_K32SRC_RC=y
# CONFIG_CLOCK_CONTROL_NRF_K32SRC_XTAL=n
# CONFIG_CLOCK_CONTROL_NRF_K32SRC_500PPM=y
# CONFIG_CLOCK_CONTROL_NRF_K32SRC_RC_CALIBRATION=y

# Enable Underglow
CONFIG_ZMK_RGB_UNDERGLOW=y
CONFIG_ZMK_RGB_UNDERGLOW_AUTO_OFF_IDLE=y

# Enable Encoder
CONFIG_EC11=y
CONFIG_EC11_TRIGGER_GLOBAL_THREAD=y
# TODO app hang on rotate
# CONFIG_EC11_TRIGGER_OWN_THREAD=y

# Enable EXT POWER
CONFIG_ZMK_EXT_POWER=y

CONFIG_USE_DT_CODE_PARTITION=y
CONFIG_BUILD_OUTPUT_UF2=y

CONFIG_MPU_ALLOW_FLASH_WRITE=y
CONFIG_NVS=y
CONFIG_SETTINGS_NVS=y
CONFIG_FLASH=y
CONFIG_FLASH_PAGE_LAYOUT=y
CONFIG_FLASH_MAP=y

CONFIG_ZMK_DISPLAY=y

CONFIG_ZMK_DISPLAY_DEDICATED_THREAD_STACK_SIZE=5120

# ensure USB stability
CONFIG_ZMK_DISPLAY_TICK_PERIOD_MS=30
CONFIG_USB_MAX_NUM_TRANSFERS=8
```

## zmk_keyboards/drivers/Kconfig
```kconfig
menu "Drivers"
rsource "display/Kconfig"
rsource "input/Kconfig"
rsource "led_strip/Kconfig"
endmenu
```

## zmk_keyboards/drivers/led_strip/Kconfig
```kconfig
# Copyright (c) 2026 The ZMK Contributors
# SPDX-License-Identifier: MIT

config SNLED27351
    bool "Sonix SNLED27351 I2C RGB LED matrix driver"
    default y
    depends on DT_HAS_SONIX_SNLED27351_ENABLED
    select I2C
    select LED_STRIP
    help
      Enable the SNLED27351 I2C RGB LED matrix driver for ZMK RGB underglow.
```

## zmk_keyboards/dts/bindings/behaviors/zmk,behavior-host-transform.yaml
```yaml
description: "Host Transform Control (Low-level Filter)"

compatible: "zmk,behavior-host-transform"

include: one_param.yaml

properties:
  map:
    type: array
    required: true
    description: "Sequence of <from-keycode to-keycode> pairs."

  save-state:
    type: boolean
    description: "Save the enabled state to flash using the device name as key"
```

## zmk_keyboards/dts/bindings/led_strip/sonix,snled27351.yaml
```yaml
# SPDX-License-Identifier: MIT

description: Sonix SNLED27351 I2C RGB LED matrix driver

compatible: "sonix,snled27351"

include: i2c-device.yaml

properties:
  chain-length:
    type: int
    required: true
    description: Number of logical RGB pixels

  pixel-channels:
    type: uint8-array
    required: true
    description: |
      Flat PWM register map. Three bytes per pixel in chain-length order:
      red channel address, green channel address, blue channel address.

  reg:
    required: true
    description: 7-bit I2C address (Keychron Q60 uses 0x74)
```
