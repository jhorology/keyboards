/*
 * Copyright (c) 2023 The ZMK Contributors
 * SPDX-License-Identifier: MIT
 */

#include "cz42.dtsi"

&default_transform {
  col-offset = <6>;
};

&kscan0 {
  col-gpios
    = <&gpio1 11 GPIO_ACTIVE_HIGH>
    , <&gpio1 13 GPIO_ACTIVE_HIGH>
    , <&gpio1 15 GPIO_ACTIVE_HIGH>
    , <&gpio0 2 GPIO_ACTIVE_HIGH>
    , <&gpio0 29 GPIO_ACTIVE_HIGH>
    , <&gpio0 31 GPIO_ACTIVE_HIGH>
    ;
};
