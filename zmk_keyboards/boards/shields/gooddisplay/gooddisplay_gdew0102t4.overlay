/*
 * Copyright (c) 2024 The ZMK Contributors
 * SPDX-License-Identifier: MIT
 */

#define POWER_SAVE

&spi_gooddisplay {
  status = "okay";
  gooddisplay_gdew0102t4: uc8175@0 {
    /*  yet another UC8175 driver   */
    compatible = "ultrachip,uc8175,ya";
    status = "okay";

    reg = <0>;
    spi-max-frequency = <8000000>;

    width = <80>;
    height = <128>;

    dc-gpios = <&gpio0 9 GPIO_ACTIVE_LOW>;
    busy-gpios = <&gpio1 6 GPIO_ACTIVE_LOW>;
    reset-gpios = <&gpio1 4 GPIO_ACTIVE_LOW>;

    /*
     * UC8175 default settings
     * driver's defalt values are optimized for GDEW0102T4
     *
     * To invert screen, swap lutw and lutb or modify cdi
     *
     * blanking = <3>;            // 0: Keep content 1: White 2: Black 3: Invert
     * blanking_on_suspend = <1>; // 0: Keep content 1: White 2: Black 3: Invert
     * psr = <0x6f>;
     * pwr = [03 00 26 26];
     * cpset = <0x3f>;
     * luptopt = [00 00];
     * pll = <17>;         // n = 0..39 (2.5Hz ~ 100Hz)  2.5Hz + 2.5Hz * n,  default 45Hz, Higer value to reduce flicker and increase ghosting
     * cdi = <0x52>;
     * vdcs = <18>;        // n = 0...58 (-0.1v ~ -3v)   -0.1v - 0.05v * n, default -1v, Higer value to increase contrast
     * pws = <0x33>;
     * tcon = <0x22>;
     * lutw = [ 60 01 01 00 00 01 80 0f 00 00 00 01 ];
     * lutb = [ 90 01 01 00 00 01 40 0f 00 00 00 01 ];
     */

    /* forcing full-screen refresh */
    full-screen-refresh;
    power-off-on-write;
    blanking=<1>;
    anti-ghosting;
    pll=<25>;
  };
};

/ {
  chosen {
    zephyr,display = &gooddisplay_gdew0102t4;
  };
};
