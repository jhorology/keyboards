## zmk_keyboards/boards/keychron_q60/Kconfig.q60
```kconfig
# Copyright (c) 2023 The ZMK Contributors
# SPDX-License-Identifier: Apache-2.0

config BOARD_Q60
    select SOC_STM32L432XX
    # TODO
    # imply RETAINED_MEM
    # imply RETENTION
    # imply RETENTION_BOOT_MODE
```

## zmk_keyboards/boards/shields/cz42/Kconfig.defconfig
```kconfig
# Copyright (c) 2024 The ZMK Contributors
# SPDX-License-Identifier: MIT

if SHIELD_CZ42_LEFT

config ZMK_KEYBOARD_NAME
    default "CZ42"

config ZMK_SPLIT_ROLE_CENTRAL
    default y

endif # SHIELD_CZ42_LEFT

if SHIELD_CZ42_LEFT || SHIELD_CZ42_RIGHT

config ZMK_SPLIT
    default y

config ZMK_RGB_UNDERGLOW
    default y
    select WS2812_STRIP

if ZMK_RGB_UNDERGLOW

config SPI
    default y

config WS2812_STRIP
    default y

endif # ZMK_RGB_UNDERGLOW

endif # SHIELD_CZ42_LEFT || SHIELD_CZ42_RIGHT
```

## zmk_keyboards/boards/shields/good_display/Kconfig.defconfig
```kconfig
# Copyright (c) 2023 The ZMK Contributors
# SPDX-License-Identifier: MIT

if SHIELD_GOOD_DISPLAY

if ZMK_DISPLAY

config ZMK_DISPLAY_BLANK_ON_IDLE
    default n

config SPI
   default y

config UC8175
    default y

config HEAP_MEM_POOL_SIZE
    default 1024

config LV_Z_BITS_PER_PIXEL
    default 1

choice LV_COLOR_DEPTH
   default LV_COLOR_DEPTH_1
endchoice

config LV_DPI_DEF
    default 145

config LV_Z_VDB_SIZE
    default 100

config LV_USE_THEME_MONO
    default y

config LV_COLOR_CHROMA_KEY_HEX
   default 0x00FF00

config LV_Z_MEM_POOL_SIZE
    default 4096

choice ZMK_DISPLAY_STATUS_SCREEN
    default ZMK_DISPLAY_STATUS_SCREEN_CUSTOM
endchoice

choice ZMK_DISPLAY_WORK_QUEUE
    default ZMK_DISPLAY_WORK_QUEUE_DEDICATED
endchoice

config ZMK_DISPLAY_DEDICATED_THREAD_STACK_SIZE
    default 4096

endif # ZMK_DISPLAY

if ZMK_DISPLAY_STATUS_SCREEN_CUSTOM

config ZMK_DISPLAY
    select LV_FONT_MONTSERRAT_26
    select LV_FONT_MONTSERRAT_16

config CUSTOM_WIDGET_BATTERY_STATUS
    bool "custom battery status widget"
    default y
    select LV_USE_IMG

config CUSTOM_WIDGET_OUTPUT_STATUS
    bool "custom output status widget"
    default y if ZMK_SPLIT_ROLE_CENTRAL
    select LV_USE_IMG

config CUSTOM_WIDGET_LAYER_STATUS
    bool "custom layer status widget"
    default y if ZMK_SPLIT_ROLE_CENTRAL
    select LV_USE_LABEL

config CUSTOM_WIDGET_PERIPHERAL_STATUS
    bool "custom peripheral status widget"
    default y  if !ZMK_SPLIT_ROLE_CENTRAL
    select LV_USE_IMG

config CUSTOM_WIDGET_LAYER_STATUS_HIDE_HEADING
	  bool "Hide heading strip for layer widget and center widgets on 1/3rds"

choice CUSTOM_WIDGET_LOGO_IMAGE
    prompt "custom logo widget image"
    default CUSTOM_WIDGET_LOGO_IMAGE_ZMK
config CUSTOM_WIDGET_LOGO_IMAGE_ZEN
    bool "Corne-ish Zen"
    select LV_USE_IMG

config CUSTOM_WIDGET_LOGO_IMAGE_LPKB
    bool "LPKB"
    select LV_USE_IMG

config CUSTOM_WIDGET_LOGO_IMAGE_ZMK
    bool "ZMK"
    select LV_USE_IMG

config CUSTOM_WIDGET_LOGO_IMAGE_MIRYOKU
    bool "Miryoku"
    select LV_USE_IMG

endchoice

endif # ZMK_DISPLAY_STATUS_SCREEN_CUSTOM

endif # SHIELD_GOOD_DISPLAY
```

## zmk_keyboards/boards/shields/good_display/Kconfig.shield
```kconfig
# Copyright (c) 2024 The ZMK Contributors
# SPDX-License-Identifier: MIT

config SHIELD_GOOD_DISPLAY
    def_bool $(shields_list_contains,good_display)
```

## zmk_keyboards/boards/shields/gooddisplay/Kconfig.defconfig
```kconfig
# Copyright (c) 2023 The ZMK Contributors
# SPDX-License-Identifier: MIT

if SHIELD_GOODDISPLAY_GDEW0102T4

config UC8175_YA
    default y

endif # SHIELD_GOODDISPLAY_GDEW0102T4
```

## zmk_keyboards/boards/shields/gooddisplay/Kconfig.shield
```kconfig
# Copyright (c) 2024 The ZMK Contributors
# SPDX-License-Identifier: MIT

config SHIELD_GOODDISPLAY_GDEW0102T4
    def_bool $(shields_list_contains,gooddisplay_gdew0102t4)
```

## zmk_keyboards/boards/shields/gooddisplay_adapter/Kconfig.defconfig
```kconfig
# Copyright (c) 2023 The ZMK Contributors
# SPDX-License-Identifier: MIT

if SHIELD_GOODDISPLAY_ADAPTER

config SPI
    default y

endif # SHIELD_GOODDISPLAY_ADAPTER
```

## zmk_keyboards/boards/shields/gooddisplay_adaptor/Kconfig.shield
```kconfig
# Copyright (c) 2024 The ZMK Contributors
# SPDX-License-Identifier: MIT

config SHIELD_GOODDISPLAY_ADAPTER
    def_bool $(shields_list_contains,gooddisplay_adapter)
```

## zmk_keyboards/boards/shields/libra_mini/Kconfig.defconfig
```kconfig
# Copyright (c) 2024 The ZMK Contributors
# SPDX-License-Identifier: MIT

if SHIELD_LIBRA_MINI

config ZMK_KEYBOARD_NAME
    default "Libra Mini"

endif # SHIELD_LIBRA_MINI
```

## zmk_keyboards/boards/shields/libra_mini/Kconfig.shield
```kconfig
# Copyright (c) 2024 The ZMK Contributors
# SPDX-License-Identifier: MIT

config SHIELD_LIBRA_MINI
    def_bool $(shields_list_contains,libra_mini)
```

## zmk_keyboards/boards_WIP/kbdfans_tofu60/Kconfig.board
```kconfig
# Copyright (c) 2023 The ZMK Contributors
# SPDX-License-Identifier: Apache-2.0

config BOARD_KBDFANS_TOFU60_V2
    bool "KBDfans Tofu60 2.0"
    depends on SOC_RP2040
```

## zmk_keyboards/boards_WIP/kbdfans_tofu60/kbdfans_tofu60_v2_defconfig
```kconfig
# Copyright (c) 2023 The ZMK Contributors
# SPDX-License-Identifier: MIT

CONFIG_SOC_SERIES_RP2XXX=y
CONFIG_SOC_RP2040=y
CONFIG_BOARD_KBDFANS_TOFU60_V2=y

CONFIG_SYS_CLOCK_HW_CYCLES_PER_SEC=125000000

# Enable reset by default
CONFIG_RESET=y

# Code partition needed to target the correct flash range
CONFIG_USE_DT_CODE_PARTITION=y

CONFIG_SETTINGS=y

# Output UF2 by default, native bootloader supports it.
CONFIG_BUILD_OUTPUT_UF2=y

# USB
CONFIG_ZMK_USB=y
CONFIG_USB_SELF_POWERED=n
# if NKRO and MAX_USAGE > 0x67, it should be increased.
# probably it's caluculated from (MAX_USAGE + 1) / 8 + 3
#  - report id 1byte
#  - modifier input 1byte
#  - reserved inout 1byte
#  - nkro input (MAX_USAGE + 1) / 8 bytes
# default: 16
CONFIG_HID_INTERRUPT_EP_MPS=32
```

## zmk_keyboards/boards_WIP/qk60/Kconfig.defconfig
```kconfig
# Copyright (c) 2023 The ZMK Contributors
# SPDX-License-Identifier: MIT

if BOARD_QK60_WIRED

config ZMK_KEYBOARD_NAME
    default "QK60 Wired"

endif # BOARD_QK60_WIRED
```

## zmk_keyboards/boards_WIP/qk60/qk60_wired_defconfig
```kconfig
# Copyright (c) 2023 The ZMK Contributors
# SPDX-License-Identifier: MIT

CONFIG_SOC_SERIES_STM32F1X=y
CONFIG_SOC_STM32F103XB=y
CONFIG_BOARD_QK60_WIRED=y

# unknown stm32F103 clone seems dosen't support
# default y
CONFIG_STACK_ALIGN_DOUBLE_WORD=n

# enable clock control
CONFIG_CLOCK_CONTROL=y

# Enable pin controller
CONFIG_PINCTRL=y

# Code partition needed to target the correct flash range
CONFIG_USE_DT_CODE_PARTITION=y

CONFIG_SETTINGS=y

# maybe need to adjust indivisual gap
# default 0
CONFIG_ZMK_KSCAN_MATRIX_WAIT_BEFORE_INPUTS=1
# default 0
CONFIG_ZMK_KSCAN_MATRIX_WAIT_BETWEEN_OUTPUTS=1

CONFIG_ZMK_USB=y
CONFIG_USB_SELF_POWERED=n

# if NKRO and MAX_USAGE > 0x67, it should be increased.
# probably it's caluculated from (MAX_USAGE + 1) / 8 + 3
#  - report id 1byte
#  - modifier input 1byte
#  - reserved inout 1byte
#  - nkro input (MAX_USAGE + 1) / 8 bytes
# default: 16
CONFIG_HID_INTERRUPT_EP_MPS=32
```

## zmk_keyboards/boards_WIP/rz42/Kconfig.board
```kconfig
# Copyright (c) 2024 The ZMK Contributors
# SPDX-License-Identifier: MIT

config BOARD_RZ42_LEFT
    bool "RZ42 Left"
    depends on SOC_NRF52840_QIAA

config BOARD_RZ42_RIGHT
    bool "RZ42 Right"
    depends on SOC_NRF52840_QIAA
```

## zmk_keyboards/boards_WIP/shields/cz42/Kconfig.shield
```kconfig
# Copyright (c) 2024 The ZMK Contributors
# SPDX-License-Identifier: MIT

config SHIELD_CZ42_LEFT
    def_bool $(shields_list_contains,cz42_left)

config SHIELD_CZ42_RIGHT
    def_bool $(shields_list_contains,cz42_right)
```

## zmk_keyboards/drivers/display/Kconfig
```kconfig
# Copyright (c) 2021 The ZMK Contributors
# SPDX-License-Identifier: MIT

if DISPLAY

rsource "Kconfig.uc8175"
rsource "Kconfig.ls0xx"

endif # DISPLAY
```

## zmk_keyboards/drivers/display/Kconfig.ls0xx
```kconfig
# Copyright (c) 2020 Rohit Gujarathi
# SPDX-License-Identifier: Apache-2.0

config LS0XX_YA
    bool "LS0XX memory display controller (yet another) driver"
    default y
    depends on DT_HAS_SHARP_LS0XX_YA_ENABLED
    select SPI
    help
      Enable driver for sharp memory display series LS0XXX7DXXX

if LS0XX_YA

config LS0XX_THREAD_STACK_SIZE
    int "Stack size for the ls0xx thread"
    default 1536
    help
      Size of the stack used for the VCOM thread.

config LS0XX_THREAD_PRIORITY
    int "Priority for the ls0xx thread"
    default 5
    help
      Priority level of the ls0xx thread.

endif
```

## zmk_keyboards/drivers/display/Kconfig.uc8175
```kconfig
# Copyright (c) 2020 Phytec Messtechnik GmbH, Peter Johanson
# SPDX-License-Identifier: Apache-2.0

config UC8175_YA
    bool "UltraChip UC8175 compatible display controller (yet another) driver"
	  default y
	  depends on DT_HAS_ULTRACHIP_UC8175_YA_ENABLED
	  select SPI
	  help
	    Enable (yet another) driver for UC8175 compatible controller.
```

## zmk_keyboards/drivers/input/Kconfig
```kconfig
# Copyright 2023 Google LLC
# SPDX-License-Identifier: Apache-2.0

if INPUT

rsource "Kconfig.analog_axis"

endif # INPUT
```

## zmk_keyboards/drivers/input/Kconfig.analog_axis
```kconfig
# Copyright 2023 Google LLC
# SPDX-License-Identifier: Apache-2.0

config INPUT_ANALOG_AXIS_YA
	bool "ADC based analog axis input driver"
	default y
	depends on DT_HAS_ANALOG_AXIS_YA_ENABLED
	depends on MULTITHREADING
	select ADC
	help
	  ADC based analog axis input driver

if INPUT_ANALOG_AXIS_YA

config INPUT_ANALOG_AXIS_YA_THREAD_STACK_SIZE
	int "Stack size for the analog axis thread"
	default 762
	help
	  Size of the stack used for the analog axis thread.

config INPUT_ANALOG_AXIS_YA_THREAD_PRIORITY
	int "Priority for the analog axis thread"
	default 0
	help
	  Priority level of the analog axis thread.

config INPUT_ANALOG_AXIS_YA_SETTINGS
	bool "Analog axis settings support"
	default y
	depends on SETTINGS
	help
	  Settings support for the analog axis driver, exposes a
	  analog_axis_calibration_save() function to save the calibration into
	  settings and load them automatically on startup.

config INPUT_ANALOG_AXIS_YA_SETTINGS_MAX_AXES
	int "Maximum number of axes supported in the settings."
	default 8
	help
	  Maximum number of axes that can have calibration value saved in
	  settings.

config INPUT_ANALOG_AXIS_YA_REPORT_USING_SYSTEM_WORKQUEUE
  bool "Use system workqueue for sending input report."
  depends on INPUT_MODE_SYNCHRONOUS
  help
    ”Useful if the listener subsystem is not thread-safe.”

endif
```

## zmk_keyboards/dts/bindings/behaviors/zmk,behavior-beep.yaml
```yaml
# Copyright (c) 2020 The ZMK Contributors
# SPDX-License-Identifier: MIT

description: Beep control Behavior

compatible: "zmk,behavior-beep"

include: one_param.yaml
```

## zmk_keyboards/dts/bindings/behaviors/zmk,behavior-hold-tap-dance.yaml
```yaml
# Copyright (c) 2022 The ZMK Contributors
# SPDX-License-Identifier: MIT

description: Hold-Tap Dance Behavior

compatible: "zmk,behavior-hold-tap-dance"

include: zero_param.yaml

properties:
  bindings:
    type: phandle-array
    required: true
  tapping-term-ms:
    type: int
    default: 200
```

## zmk_keyboards/dts/bindings/behaviors/zmk,behavior-rc-dial.yaml
```yaml
# Copyright (c) 2020 The ZMK Contributors
# SPDX-License-Identifier: MIT

description: Radial Controller Dial Behavior

compatible: "zmk,behavior-rc-dial"

include: zero_param.yaml

properties:
  degrees-per-click-x10:
    type: int
    default: 0
```
