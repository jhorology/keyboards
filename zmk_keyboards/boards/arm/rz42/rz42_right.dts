/*
 * Copyright (c) 2024 The ZMK Contributors
 * SPDX-License-Identifier: MIT
 */

/dts-v1/;
#include "rz42.dtsi"

&default_transform {
  col-offset = <6>;
};

&kscan0 {
  col-gpios
    = <&gpio0 22 GPIO_ACTIVE_HIGH>
    , <&gpio0 29 GPIO_ACTIVE_HIGH>
    , <&gpio0 3 GPIO_ACTIVE_HIGH>
    , <&gpio0 28 GPIO_ACTIVE_HIGH>
    , <&gpio0 30 GPIO_ACTIVE_HIGH>
    , <&gpio0 21 GPIO_ACTIVE_HIGH>
    , <&gpio0 23 GPIO_ACTIVE_HIGH>
    ;
};
