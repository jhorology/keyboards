/*
 * Copyright (c) 2024 The ZMK Contributors
 * SPDX-License-Identifier: MIT
 */

/dts-v1/;
#include "rz42.dtsi"

/ {
  sensors {
		compatible = "zmk,keymap-sensors";
		sensors = <&encoder0>;
    triggers-per-rotation = <30>;
	};

  encoder0: encoder0 {
		compatible = "alps,ec11";
	  a-gpios = <&gpio1 10 (GPIO_ACTIVE_HIGH | GPIO_PULL_UP)>;
	  b-gpios = <&gpio1 14 (GPIO_ACTIVE_HIGH | GPIO_PULL_UP)>;
    steps = <60>;
	};
};

&kscan0 {
  col-gpios
    = <&gpio0 3 GPIO_ACTIVE_HIGH>
    , <&gpio0 28 GPIO_ACTIVE_HIGH>
    , <&gpio0 30 GPIO_ACTIVE_HIGH>
    , <&gpio0 21 GPIO_ACTIVE_HIGH>
    , <&gpio0 23 GPIO_ACTIVE_HIGH>
    , <&gpio0 22 GPIO_ACTIVE_HIGH>
    ;
};
