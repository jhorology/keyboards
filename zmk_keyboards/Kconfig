## zmk_keyboards/app/Kconfig
```kconfig
menu "ZMK Extends"

if ZMK_HID_REPORT_TYPE_NKRO

config ZMK_HID_KEYBOARD_NKRO_MAX_USAGE
    hex "# Maximum Usage ID Reportable"
    default 0x97

endif # ZMK_HID_REPORT_TYPE_NKRO

# TODO maybe better to define in device-tree as property of keymap
config ZMK_HID_EXTRA_KEYS
    bool "Enable extra keys"
    default y

if ZMK_HID_EXTRA_KEYS

# --------------------------------------------
# CONFIG_ZMK_EXTRA_KEY_n (n=0...7)
#  value : 0xaabbcccc
#   aa bit24..31: usage page for collection
#   bb bit16..23: usage for collection if aa != 0
#                 usage page if aa == 0
#   cccc bit0..15: usage
#  keycode in keymap -> 0x00bbcccc
#  TODO  16bit usage/usage_page is not supported
#  TODO  maybe better to define in device-tree
# --------------------------------------------

config ZMK_HID_EXTRA_KEY_0
    hex "Extra key code 0"
    default 0x00ff0003
config ZMK_HID_EXTRA_KEY_1
    hex "Extra key code 1"
    default 0x0180009b
config ZMK_HID_EXTRA_KEY_2
    hex "Extra key code 2"
    default 0x0
config ZMK_HID_EXTRA_KEY_3
    hex "Extra key code 3"
    default 0x0
config ZMK_HID_EXTRA_KEY_4
    hex "Extra key code 4"
    default 0x0
config ZMK_HID_EXTRA_KEY_5
    hex "Extra key code 5"
    default 0x0
config ZMK_HID_EXTRA_KEY_6
    hex "Extra key code 6"
    default 0x0
config ZMK_HID_EXTRA_KEY_7
    hex "Extra key code 7"
    default 0x0

endif # ZMK_HID_EXTRA_KEYS

config ZMK_USB_HOST_OS
    bool "Enable uato switch layer"
    select USB_DETECT_HOST_OS


# TODO maybe better to define in device-tree as property of keymap
config ZMK_USB_AUTO_SWITCH_LAYER
    bool "Enable uato switch layer"
    default y if ZMK_USB
    select ZMK_USB_HOST_OS

if ZMK_USB_AUTO_SWITCH_LAYER

# TODO maybe better to define in device-tree
config ZMK_USB_AUTO_SWITCH_LAYER_IF_DARWIN
    int "Mac layer"
    default 0

# TODO maybe better to define in device-tree
config ZMK_USB_AUTO_SWITCH_LAYER_UNLESS_DARWIN
    int "Win layer"
    default 1

endif # ZMK_AUTO_SWITCH_LAYER

endmenu
```

## zmk_keyboards/app/dts/bindings/behaviors/zmk,behavior-rc-button.yaml
```yaml
# Copyright (c) 2020 The ZMK Contributors
# SPDX-License-Identifier: MIT

description: Radial Controller Button Behavior

compatible: "zmk,behavior-rc-button"

include: zero_param.yaml
```

## zmk_keyboards/boards/arm/WIP_keychron_q60/keychron_q60_defconfig
```kconfig
# Copyright (c) 2023 The ZMK Contributors
# SPDX-License-Identifier: MIT

CONFIG_SOC_SERIES_STM32L4X=y
CONFIG_SOC_STM32L432XX=y
CONFIG_BOARD_KEYCHRON_Q60=y

# Enable MPU
CONFIG_ARM_MPU=y

# Enable HW stack protection
CONFIG_HW_STACK_PROTECTION=y

# enable GPIO
CONFIG_GPIO=y

# enable clock control
CONFIG_CLOCK_CONTROL=y

# enable pin controller
# CONFIG_PINCTRL=y

# Output .bin
CONFIG_BUILD_OUTPUT_BIN=y

CONFIG_USB_SELF_POWERED=n

# Enable USB CDC ACM logging for debugging
# CONFIG_ZMK_USB_LOGGING=y
```

## zmk_keyboards/boards/arm/WIP_qk60/Kconfig.defconfig
```kconfig
# Copyright (c) 2023 The ZMK Contributors
# SPDX-License-Identifier: MIT

if BOARD_QK60_WIRED

config ZMK_KEYBOARD_NAME
    default "QK60 Wired"

config ZMK_USB
    default y

endif # BOARD_QK60_WIRED
```

## zmk_keyboards/boards/arm/WIP_qk60/qk60_wired_defconfig
```kconfig
# Copyright (c) 2023 The ZMK Contributors
# SPDX-License-Identifier: MIT

CONFIG_SOC_SERIES_STM32F1X=y
CONFIG_SOC_STM32F103XB=y
CONFIG_BOARD_QK60_WIRED=y

# Code partition needed to target the correct flash range
CONFIG_USE_DT_CODE_PARTITION=y

# Output .bin
CONFIG_BUILD_OUTPUT_BIN=y

# reduce SRAM usage
# default: 8192
CONFIG_HEAP_MEM_POOL_SIZE=7168

CONFIG_USB_SELF_POWERED=n

# Enable USB CDC ACM logging for debugging
# Can't usable beacuase memory usage exceed.
# CONFIG_ZMK_USB_LOGGING=y
```

## zmk_keyboards/boards/arm/bt60/Kconfig.defconfig
```kconfig
# Copyright (c) 2021 Polarity Works
# SPDX-License-Identifier: MIT

if BOARD_BT60

config ZMK_KEYBOARD_NAME
    default "BT60"

if USB_DEVICE_STACK

config USB_NRFX
    default y

endif # USB_DEVICE_STACK

config BT_CTLR
    default BT

endif # OARD_BT60
```

## zmk_keyboards/boards/arm/cyber60_rev_d/cyber60_rev_d_defconfig
```kconfig
# SPDX-License-Identifier: MIT

CONFIG_SOC_SERIES_NRF52X=y
CONFIG_SOC_NRF52840_QIAA=y
CONFIG_BOARD_CYBER60_REV_D=y

# Enable MPU
CONFIG_ARM_MPU=y

# enable pinctrl
CONFIG_PINCTRL=y

# enable GPIO
CONFIG_GPIO=y

CONFIG_USE_DT_CODE_PARTITION=y
CONFIG_BUILD_OUTPUT_UF2=y

# enable pwm
CONFIG_PWM=y
CONFIG_PWM_NRFX=y

CONFIG_MPU_ALLOW_FLASH_WRITE=y
CONFIG_NVS=y
CONFIG_SETTINGS_NVS=y
CONFIG_FLASH=y
CONFIG_FLASH_PAGE_LAYOUT=y
CONFIG_FLASH_MAP=y

# set TX power level
# CONFIG_BT_CTLR_TX_PWR_PLUS_8=y // Recommended if used in a metal enclosure

# Enable Underglow
CONFIG_ZMK_RGB_UNDERGLOW=y
CONFIG_WS2812_STRIP=y
CONFIG_ZMK_RGB_UNDERGLOW_EXT_POWER=y
CONFIG_ZMK_RGB_UNDERGLOW_ON_START=n

CONFIG_ZMK_USB=y
CONFIG_ZMK_BLE=y

# if NKRO and MAX_USAGE > 0x67, it should be increased.
# probably it's caluculated from (MAX_USAGE + 1) / 8 + 3
#  - report id 1byte
#  - modifier input 1byte
#  - reserved inout 1byte
#  - nkro input (MAX_USAGE + 1) / 8 bytes
# default: 16
# nrf seem to msut be power of 2
CONFIG_HID_INTERRUPT_EP_MPS=32
```

## zmk_keyboards/boards/arm/fk680pro/Kconfig.board
```kconfig
# Copyright (c) 2023 The ZMK Contributors
# SPDX-License-Identifier: Apache-2.0

config BOARD_FK680PRO_V2
    bool "FK680 Pro V2"
 	  depends on SOC_STM32F103XB
```

## zmk_keyboards/boards/arm/fk680pro/Kconfig.defconfig
```kconfig
# Copyright (c) 2023 The ZMK Contributors
# SPDX-License-Identifier: MIT

if BOARD_FK680PRO_V2

config ZMK_KEYBOARD_NAME
    default "FK680 Pro V2"

config ZMK_USB
    default y

if BUILD_OUTPUT_UF2

config BUILD_OUTPUT_UF2_USE_FLASH_BASE
    default y

config BUILD_OUTPUT_UF2_USE_FLASH_OFFSET
    default y


# See https://github.com/microsoft/uf2/blob/master/utils/uf2families.json
config BUILD_OUTPUT_UF2_FAMILY_ID
    default "0x5ee21072"

endif # BUILD_OUTPUT_UF2

endif # BOARD_FK680PRO_V2
```

## zmk_keyboards/boards/arm/fk680pro/fk680pro_v2_defconfig
```kconfig
# Copyright (c) 2023 The ZMK Contributors
# SPDX-License-Identifier: MIT

CONFIG_SOC_SERIES_STM32F1X=y
CONFIG_SOC_STM32F103XB=y
CONFIG_BOARD_FK680PRO_V2=y

# enable clock control
CONFIG_CLOCK_CONTROL=y

# enable pin controller
CONFIG_PINCTRL=y

# Code partition needed to target the correct flash range
CONFIG_USE_DT_CODE_PARTITION=y

# Output UF2
CONFIG_BUILD_OUTPUT_UF2=y

# reduce SRAM usage
# default: 8192
CONFIG_HEAP_MEM_POOL_SIZE=6144

CONFIG_USB_SELF_POWERED=n

# maybe need to adjust indivisual gap
# default 0
CONFIG_ZMK_KSCAN_MATRIX_WAIT_BEFORE_INPUTS=1
# default 0
# CONFIG_ZMK_KSCAN_MATRIX_WAIT_BETWEEN_OUTPUTS=1

# if NKRO and MAX_USAGE > 0x67, it should be increased.
# probably it's caluculated from (MAX_USAGE + 1) / 8 + 3
#  - report id 1byte
#  - modifier input 1byte
#  - reserved inout 1byte
#  - nkro input (MAX_USAGE + 1) / 8 bytes
# default: 16
CONFIG_HID_INTERRUPT_EP_MPS=22
```

## zmk_keyboards/boards/arm/kbdfans_tofu60/Kconfig.defconfig
```kconfig
# Copyright (c) 2023 The ZMK Contributors
# SPDX-License-Identifier: MIT

if BOARD_KBDFANS_TOFU60_V2

config ZMK_KEYBOARD_NAME
    default "kbdfans tofu60"

config RP2_FLASH_W25Q080
    default y

endif # BOARD_KBDFANS_TOFU60_V2
```

## zmk_keyboards/boards/arm/keychron_q60/Kconfig.board
```kconfig
# Copyright (c) 2023 The ZMK Contributors
# SPDX-License-Identifier: Apache-2.0

config BOARD_KEYCHRON_Q60
    bool "Keychron Q60"
    depends on SOC_STM32L432XX
```

## zmk_keyboards/boards/arm/keychron_q60/Kconfig.defconfig
```kconfig
# Copyright (c) 2023 The ZMK Contributors
# SPDX-License-Identifier: MIT

if BOARD_KEYCHRON_Q60

config ZMK_KEYBOARD_NAME
    default "Keychron Q60"

config SPI_STM32_INTERRUPT
	default y
	depends on SPI

config ZMK_USB
    default y

endif # BOARD_KEYCHRON_Q60
```

## zmk_keyboards/boards/arm/keychron_q60/keychron_q60_defconfig
```kconfig
# Copyright (c) 2023 The ZMK Contributors
# SPDX-License-Identifier: MIT

CONFIG_SOC_SERIES_STM32L4X=y
CONFIG_SOC_STM32L432XX=y
CONFIG_BOARD_KEYCHRON_Q60=y

CONFIG_HW_STACK_PROTECTION=y
CONFIG_ARM_MPU=y
CONFIG_CLOCK_CONTROL=y
CONFIG_PINCTRL=y

# Use polling instead of intrrupt for kscan
# some gpio input pins are exists on same EXTI line.
CONFIG_ZMK_KSCAN_MATRIX_POLLING=y

# Increase stack size
# default 1024
CONFIG_SYSTEM_WORKQUEUE_STACK_SIZE=2048


# USB
CONFIG_ZMK_USB=y
CONFIG_USB_SELF_POWERED=n

# USB HID Device Interrupt Endpoint size
#
# if NKRO and MAX_USAGE > 0x67, it should be increased.
# probably it's caluculated from (MAX_USAGE + 1) / 8 + 3
#  - report id 1byte
#  - modifier input 1byte
#  - reserved inout 1byte
#  - nkro input (MAX_USAGE + 1) / 8 bytes
# default: 16
CONFIG_HID_INTERRUPT_EP_MPS=32
```

## zmk_keyboards/boards/arm/qk60/Kconfig.board
```kconfig
# Copyright (c) 2023 The ZMK Contributors
# SPDX-License-Identifier: Apache-2.0

config BOARD_QK60_WIRED
    bool "QK60 Wired"
    depends on SOC_STM32F103XB
```

## zmk_keyboards/boards/arm/qk60/qk60_wired_defconfig
```kconfig
# Copyright (c) 2023 The ZMK Contributors
# SPDX-License-Identifier: MIT

CONFIG_SOC_SERIES_STM32F1X=y
CONFIG_SOC_STM32F103XB=y
CONFIG_BOARD_QK60_WIRED=y

# this unknown stm32F103 clone seems not supported
# default y
CONFIG_STACK_ALIGN_DOUBLE_WORD=n

# enable clock control
CONFIG_CLOCK_CONTROL=y

# enable pin controller
CONFIG_PINCTRL=y

# Code partition needed to target the correct flash range
CONFIG_USE_DT_CODE_PARTITION=y

# reduce SRAM usage
# default: 8192
CONFIG_HEAP_MEM_POOL_SIZE=6144

CONFIG_USB_SELF_POWERED=n

# maybe need to adjust indivisual gap
# default 0
CONFIG_ZMK_KSCAN_MATRIX_WAIT_BEFORE_INPUTS=1
# default 0
CONFIG_ZMK_KSCAN_MATRIX_WAIT_BETWEEN_OUTPUTS=1

# if NKRO and MAX_USAGE > 0x67, it should be increased.
# probably it's caluculated from (MAX_USAGE + 1) / 8 + 3
#  - report id 1byte
#  - modifier input 1byte
#  - reserved inout 1byte
#  - nkro input (MAX_USAGE + 1) / 8 bytes
# default: 16
CONFIG_HID_INTERRUPT_EP_MPS=22
```

## zmk_keyboards/boards/arm/rz42/Kconfig.defconfig
```kconfig
# Copyright (c) 2024 The ZMK Contributors
# SPDX-License-Identifier: MIT

if BOARD_RZ42_LEFT

config ZMK_KEYBOARD_NAME
    default "RZ42"

endif # BOARD_RZ42_LEFT

if BOARD_RZ42_LEFT || BOARD_RZ42_RIGHT

config BOARD_ENABLE_DCDC
    bool "Enable DCDC mode"
    select SOC_DCDC_NRF52X
    default y

config BOARD_ENABLE_DCDC_HV
    bool "Enable High Voltage DCDC converter"
    default y
    select SOC_DCDC_NRF52X_HV

if USB_DEVICE_STACK

config USB_NRFX
    default y

endif # USB_DEVICE_STACK

config BT_CTLR
    default BT

endif # BOARD_RZ42_LEFT || BOARD_RZ42_RIGHT
```

## zmk_keyboards/boards/cyber60_rev_d/Kconfig.cyber60_rev_d
```kconfig
# Copyright (c) 2021 Nick Winans
# SPDX-License-Identifier: Apache-2.0

config BOARD_CYBER60_REV_D
    select SOC_NRF52840_QIAA
    imply RETAINED_MEM
    imply RETENTION
    imply RETENTION_BOOT_MODE
```

## zmk_keyboards/boards/cyber60_rev_d/Kconfig.defconfig
```kconfig
# Copyright (c) 2020 Stefan Sundin (4pplet)
# SPDX-License-Identifier: MIT

if BOARD_CYBER60_REV_D

config ZMK_KEYBOARD_NAME
	default "cyber60 Rev D"

if USB_DEVICE_STACK

config USB_NRFX
    default y

endif # USB_DEVICE_STACK

config BT_CTLR
    default BT

endif # BOARD_CYBER60_REV_D
```

## zmk_keyboards/boards/kbdfans_tofu60/Kconfig.defconfig
```kconfig
# Copyright (c) 2023 The ZMK Contributors
# SPDX-License-Identifier: MIT

if BOARD_TOFU60V2

config ZMK_KEYBOARD_NAME
    default "kbdfans tofu60 2.0"

config RP2_FLASH_W25Q080
    default y

endif # BOARD_TOFU60V2
```

## zmk_keyboards/boards/kbdfans_tofu60/tofu60v2_defconfig
```kconfig
# Copyright (c) 2023 The ZMK Contributors
# SPDX-License-Identifier: MIT

CONFIG_SYS_CLOCK_HW_CYCLES_PER_SEC=125000000

# Enable reset by default
CONFIG_RESET=y
CONFIG_CLOCK_CONTROL=y

# Code partition needed to target the correct flash range
CONFIG_USE_DT_CODE_PARTITION=y

CONFIG_SETTINGS=y

# Output UF2 by default, native bootloader supports it.
CONFIG_BUILD_OUTPUT_UF2=y

# USB
CONFIG_ZMK_USB=y
CONFIG_USB_SELF_POWERED=n
# if NKRO and MAX_USAGE > 0x67, it should be increased.
# probably it's caluculated from (MAX_USAGE + 1) / 8 + 3
#  - report id 1byte
#  - modifier input 1byte
#  - reserved inout 1byte
#  - nkro input (MAX_USAGE + 1) / 8 bytes
# default: 16
CONFIG_HID_INTERRUPT_EP_MPS=32
```

## zmk_keyboards/boards/keychron_q60/Kconfig.defconfig
```kconfig
# Copyright (c) 2023 The ZMK Contributors
# SPDX-License-Identifier: MIT

if BOARD_Q60

config ZMK_KEYBOARD_NAME
    default "Keychron Q60"

endif # BOARD_Q60
```
